## main/Kconfig.projbuild
```kconfig
menu "ESP32Toy Configuration"

    config ESP32TOY_BLINK_GPIO
        int "Blink GPIO number"
        default 2
        range 0 39
        help
            GPIO number for the LED blink.

endmenu
```

## sdkconfig.defaults
```kconfig
# ESP32Toy sdkconfig defaults
# 默认配置适用于 ESP32-DevKitC

# 启用日志
CONFIG_LOG_DEFAULT_LEVEL_INFO=y
CONFIG_LOG_DEFAULT_LEVEL=3

# FreeRTOS 配置
CONFIG_FREERTOS_HZ=1000

# 启用自动启动
CONFIG_BOOTLOADER_LOG_LEVEL_INFO=y
```
